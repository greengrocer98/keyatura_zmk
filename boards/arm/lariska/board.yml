## boards/arm/lariska_zmk_v3/Kconfig.board
```kconfig
# nice!nano board configuration

# Copyright (c) 2020 Pete Johanson
# SPDX-License-Identifier: MIT

config BOARD_LARISKA_V3
    bool "lariska"
    depends on SOC_NRF52840_QIAA
    
config BOARD_ENABLE_DCDC
    bool "Enable DCDC mode"
    select SOC_DCDC_NRF52X
    default y
    depends on (BOARD_LARISKA_V3)

config BOARD_ENABLE_DCDC_HV
    bool "High voltage DCDC converter"
    select SOC_DCDC_NRF52X_HV
    default n
    depends on (BOARD_LARISKA_V3)
```

## boards/arm/lariska_zmk_v3/Kconfig.defconfig
```kconfig
# Copyright (c) 2021 The ZMK Contributors
# SPDX-License-Identifier: MIT

if BOARD_LARISKA_V3

config BOARD
    default "lariska"

if USB_DEVICE_STACK

config USB_NRFX
    default y

endif # USB_DEVICE_STACK

config BT_CTLR
    default BT

endif # BOARD_LARISKA_V3
```

## boards/shields/keyatura/Kconfig.defconfig
```kconfig
if SHIELD_KEYATURA_DONGLE

config ZMK_KEYBOARD_NAME
    default "key_lariska"

config ZMK_SPLIT_ROLE_CENTRAL
    default y

config ZMK_SPLIT_BLE_CENTRAL_PERIPHERALS
    default 1

endif

if SHIELD_KEYATURA_DONGLE || SHIELD_KEYATURA_MOUSE

config ZMK_SPLIT
    default y

endif
```

## boards/shields/keyatura/Kconfig.shield
```kconfig
config SHIELD_KEYATURA_DONGLE
    def_bool $(shields_list_contains,keyatura_dongle)

config SHIELD_KEYATURA_MOUSE
    def_bool $(shields_list_contains,keyatura_mouse)
```

## config/west.yml
```yaml
manifest:
  remotes:
    - name: zmkfirmware
      url-base: https://github.com/zmkfirmware
    - name: ggrocer
      url-base: https://github.com/greengrocer98
    - name: badjeff
      url-base: https://github.com/badjeff
    - name: nrfconnect
      url-base: https://github.com/nrfconnect
  projects:
    - name: zmk
      remote: zmkfirmware
      revision: main
      import: app/west.yml
    - name: zmk-paw3395-driver
      remote: ggrocer
      revision: main
    - name: zmk-feature-split-esb
      remote: badjeff
      revision: main  
    - name: sdk-nrf
      remote: badjeff
      revision: v3.1-branch+zmk-fixes
      path: nrf
    - name: nrfxlib
      remote: nrfconnect
      revision: v3.1-branch
      repo-path: sdk-nrfxlib
      path: nrfxlib 
  self:
    path: config
```
